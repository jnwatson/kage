## security/kage/Kconfig
```kconfig
# SPDX-License-Identifier: GPL-2.0-only
config SECURITY_KAGE
	bool "Enable LFI-based sandboxing of other kernel modules"
	default n
	help
	   Enable this to allow specially-built kernel modules to be sandboxed.
	   The sandbox restricts the module's access to memory and kernel functions.
```
